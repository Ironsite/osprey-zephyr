## drivers/flash/Kconfig.stm32_xspi
```kconfig
# STM32 xSPI flash driver configuration options

# Copyright (c) 2024 STMicroelectronics
# SPDX-License-Identifier: Apache-2.0

DT_STM32_XSPI_HAS_DMA := $(dt_compat_any_has_prop,$(DT_COMPAT_ST_STM32_XSPI),dmas)

config FLASH_STM32_XSPI
	bool "STM32 XSPI Flash driver"
	default y
	depends on DT_HAS_ST_STM32_XSPI_ENABLED && DT_HAS_ST_STM32_XSPI_NOR_ENABLED
	select USE_STM32_HAL_XSPI
	select USE_STM32_LL_DLYB
	select FLASH_HAS_DRIVER_ENABLED
	select FLASH_JESD216
	select FLASH_PAGE_LAYOUT
	select FLASH_HAS_PAGE_LAYOUT
	select FLASH_HAS_EXPLICIT_ERASE
	select PINCTRL
	help
	  Enable XSPI-NOR support on the STM32 family of processors.

if FLASH_STM32_XSPI

config FLASH_STM32_XSPI_DMA
	bool "DMA Support for STM32 XSPI Flash"
	depends on $(DT_STM32_XSPI_HAS_DMA)
	default y
	select DMA
	select USE_STM32_HAL_DMA
	select USE_STM32_HAL_DMA_EX if (SOC_SERIES_STM32H5X || \
		SOC_SERIES_STM32N6X || SOC_SERIES_STM32H7RSX)
	help
	  Enable the DMA mode for XSPI flash driver instance

endif # FLASH_STM32_XSPI

config FLASH_STM32_XSPI_SFDP_DUMP
	bool "Dump the SFDP parameter tables at init"
	depends on FLASH_STM32_XSPI
	help
	  Print every SFDP parameter header the memory publishes, and the raw
	  dwords of each table, while the part is still in 1-line SPI mode.
	  Bring-up aid: the xSPI Profile 1.0 table (id 0xff05) describes how a
	  part wants to be put into octal mode, which this driver otherwise
	  hardcodes to the Macronix convention. SFDP cannot be read once the
	  peripheral is memory-mapped, so this has to happen at init.

config FLASH_STM32_XSPI_OPI_MICRON
	bool "Enter octal mode using the Micron/ISSI convention"
	depends on FLASH_STM32_XSPI
	help
	  This driver enables octal mode the Macronix way: write configuration
	  register 2 (opcode 0x72) at address 0 with 0x01 (STR) or 0x02 (DTR).
	  Micron-convention xSPI parts, which include the ISSI IS25WX series,
	  instead write the volatile configuration register (opcode 0x81) at
	  address 0 with 0xe7.

	  Say y for an ISSI IS25WX256. The values here are exactly what such a
	  part publishes in its own SFDP "Command Sequences to Change to Octal
	  DDR mode" table (id 0xff0a); dump it with
	  CONFIG_FLASH_STM32_XSPI_SFDP_DUMP to confirm for another part.
```

## drivers/video/Kconfig.stm32_venc
```kconfig
# STM32 VENC driver configuration options

# Copyright (c) 2025 STMicroelectronics.
# SPDX-License-Identifier: Apache-2.0

config VIDEO_STM32_VENC
	bool "STM32 video encoder (VENC) driver"
	default y
	depends on DT_HAS_ST_STM32_VENC_ENABLED
	depends on VIDEO_ENCODER_H264
	select HAS_STM32LIB
	select USE_STM32_LL_VENC
	select RESET
	help
	  Enable driver for STM32 video encoder peripheral.

if VIDEO_STM32_VENC

# See hal_stm32/lib/vc8000nanoe/inc/encdebug.h
module = VC8000NANOE
module-str = vc8000nanoe
source "subsys/logging/Kconfig.template.log_config"

choice VIDEO_STM32_VENC_MEM_ALLOC
	prompt "Select allocator for VENC internal memory"

config VIDEO_STM32_VENC_SMH_ALLOC
	bool "Shared-Multi-Heap"

config VIDEO_STM32_VENC_HEAP_ALLOC
	bool "Heap"

endchoice

config VIDEO_STM32_VENC_HEAP_SIZE
	int "VENC internal memory pool size in byte"
	depends on VIDEO_STM32_VENC_HEAP_ALLOC
	default 7340032

config VIDEO_STM32_VENC_HEAP_ZEPHYR_REGION
	bool "Place VENC internal memory pool in a Zephyr memory-region"
	depends on VIDEO_STM32_VENC_HEAP_ALLOC

config VIDEO_STM32_VENC_HEAP_ZEPHYR_REGION_NAME
	string "Name of the zephyr memory-region for memory pool"
	depends on VIDEO_STM32_VENC_HEAP_ZEPHYR_REGION

config VIDEO_STM32_VENC_FRAMERATE
	int "Frame rate declared to the encoder (fps)"
	default 30
	help
	  Must match the rate frames are actually delivered at. The rate control
	  budget is bitPerSecond divided by this, so a mismatch scales the
	  per-picture bit allowance by exactly the ratio: declaring 30 while
	  capturing at 5 starves every picture to a sixth of its budget. It also
	  goes into the SPS timing information.

config VIDEO_STM32_VENC_BITRATE
	int "Target bitrate in bits/second, 0 for constant QP"
	default 0
	help
	  0 keeps the original fixed-QP behaviour, where the bitrate is whatever
	  the scene happens to cost. Any other value enables picture and
	  macroblock rate control against that target, which is what you want
	  when there is a link budget to respect. Range accepted by the encoder
	  is 10000 to 60000000.

config VIDEO_STM32_VENC_QP
	int "Initial quantisation parameter"
	range 0 51
	default 25
	help
	  With rate control off this is THE quality setting and is used for every
	  picture. With rate control on it is only the starting point.

config VIDEO_STM32_VENC_QP_MIN
	int "Lowest quantisation parameter rate control may use"
	range 0 51
	default 10

config VIDEO_STM32_VENC_QP_MAX
	int "Highest quantisation parameter rate control may use"
	range 0 51
	default 51
	help
	  The quality floor. Lowering it stops the controller dumping quality on
	  a hard scene, at the cost of overshooting the bitrate target.

config VIDEO_STM32_VENC_GOP_LEN
	int "Distance between intra pictures, in frames"
	range 1 300
	default 30
	help
	  Also drives where the driver forces an intra picture, so that intra
	  placement and the rate controller's per-GOP bit budget agree.

config VIDEO_STM32_VENC_INTRA_QP_DELTA
	int "Intra picture QP offset"
	range -12 12
	default -3
	help
	  Negative spends extra bits on intra pictures. Since every following
	  picture predicts from them, a sharper anchor improves the whole GOP.

config VIDEO_STM32_VENC_TRANSFORM_8X8
	int "High profile 8x8 transform: 0 off, 1 adaptive, 2 always"
	range 0 2
	default 0
	help
	  0 pins the stream to Main profile. 1 lets the encoder choose per
	  macroblock, which preserves fine detail noticeably better at a given
	  bitrate and is the single largest coding-efficiency win available on
	  this hardware. Requires a High profile capable decoder.

config VIDEO_STM32_VENC_CABAC
	int "Entropy coder: 0 CAVLC (Baseline), 1 CABAC"
	range 0 1
	default 1
	help
	  CABAC costs a little encode time and buys roughly 10 percent bitrate at
	  the same quality.

endif
```
